## boards/shields/alt_corne/Kconfig.defconfig
```kconfig
if SHIELD_ALT_CORNE_LEFT

config ZMK_KEYBOARD_NAME
    default "Corne"

config ZMK_SPLIT_BLE_ROLE_CENTRAL
    default y

endif

if SHIELD_ALT_CORNE_RIGHT

config ZMK_KEYBOARD_NAME
    default "Corne R"

CONFIG_ZMK_SPLIT_ROLE_CENTRAL
default n

endif

if SHIELD_ALT_CORNE_LEFT || SHIELD_ALT_CORNE_RIGHT

CONFIG_ZMK_SPLIT
    default y

CONFIG_ZMK_BLE
    default y

endif
```

## boards/shields/alt_corne/Kconfig.shield
```kconfig
# Copyright (c) 2020 Pete Johanson
# SPDX-License-Identifier: MIT

config SHIELD_ALT_CORNE_LEFT
    def_bool $(shields_list_contains,alt_corne_left)

config SHIELD_ALT_CORNE_RIGHT
    def_bool $(shields_list_contains,alt_corne_right)
```
